## samples/net/openthread/coap/boards/beagleconnect_freedom.conf
```kconfig
# Enable BeagleConnect Freedom SubGHz radio
CONFIG_IEEE802154=y
CONFIG_IEEE802154_CC13XX_CC26XX_SUB_GHZ=y

# Specify SubG channel
CONFIG_OPENTHREAD_CHANNEL=1

# Increase stack/heap size and protection
CONFIG_MAIN_STACK_SIZE=8192
CONFIG_HEAP_MEM_POOL_SIZE=8192
CONFIG_SYSTEM_WORKQUEUE_STACK_SIZE=2048
CONFIG_HW_STACK_PROTECTION=y

# Shell
CONFIG_SHELL_ARGC_MAX=26
CONFIG_SHELL_CMD_BUFF_SIZE=512
CONFIG_SHELL_STACK_SIZE=5120

##
## ChatGPT debugging
##

# more stacks
CONFIG_SYSTEM_WORKQUEUE_STACK_SIZE=2048
CONFIG_NET_TX_STACK_SIZE=2048
CONFIG_NET_RX_STACK_SIZE=2048

# overlay-debug.conf
CONFIG_ASSERT=y
CONFIG_PRINTK=y
CONFIG_LOG=y
CONFIG_LOG_MODE_DEFERRED=n
CONFIG_FAULT_DUMP=2
CONFIG_DEBUG_OPTIMIZATIONS=y
CONFIG_OPENTHREAD_L2_LOG_LEVEL_DBG=y
CONFIG_IEEE802154_DRIVER_LOG_LEVEL_DBG=y
CONFIG_NET_BUF_LOG_LEVEL_DBG=y
CONFIG_NET_PKT_LOG_LEVEL_DBG=y
CONFIG_NET_IF_LOG_LEVEL_DBG=y
CONFIG_NET_CONFIG_LOG_LEVEL_DBG=y

# Catch stack issues early
CONFIG_THREAD_ANALYZER=y
CONFIG_THREAD_NAME=y
CONFIG_THREAD_STACK_INFO=y
CONFIG_INIT_STACKS=y

# Heap debugging
CONFIG_SYS_HEAP_VALIDATE=y
CONFIG_SYS_HEAP_RUNTIME_STATS=y

# Net/OT extra logs (tune as needed)
CONFIG_NET_LOG=y
```
